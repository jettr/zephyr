## dts/bindings/ec_host_cmd_perhip/zephyr,spi-ec-host-cmd.yaml
```yaml
# SPDX-License-Identifier: Apache-2.0

description: SPI-based EC Host Command Peripheral

compatible: "zephyr,spi-ec-host-cmd"

include: base.yaml

properties:
    label:
      required: true
```
